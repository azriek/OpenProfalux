## firmware/main/Kconfig.projbuild
```kconfig
menu "OpenProfalux"

choice OPENPROFALUX_TARGET
    prompt "Cible materielle"
    default OPENPROFALUX_TARGET_EXTERNAL
    help
      Selectionne le pinout CC1101. Voir docs/WIRING.md pour le cablage
      correspondant a chaque cible.

config OPENPROFALUX_TARGET_EXTERNAL
    bool "ESP32 DevKit + CC1101 externe (VSPI : MISO19 MOSI23 SCK18 CSN5 GDO0 4)"

config OPENPROFALUX_TARGET_M5STACK
    bool "M5Stack ATOM Lite (HSPI : MISO33 MOSI23 SCK19 CSN22 GDO0 25)"

endchoice

config OPENPROFALUX_EXTERNAL_GDO0_GPIO
    int "GPIO relie a GDO0 du CC1101"
    depends on OPENPROFALUX_TARGET_EXTERNAL
    range 0 33
    default 4
    help
      GDO0 sert en entree (reception) et en sortie (emission) : il faut un
      GPIO bidirectionnel, donc pas 34-39 (entree seule) ni 6-11 (flash).
      Eviter aussi les broches de demarrage 0, 2, 12 et 15. Sur une
      D1 mini ESP32 ou IO4 manque, IO26 (D0) convient.

endmenu
```
